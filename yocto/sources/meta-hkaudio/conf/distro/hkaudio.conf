## yocto/sources/meta-hkaudio/conf/distro/hkaudio.conf
```bitbake
require conf/distro/poky.conf

# ----------------------------------------------------------------------------------------------------------------------
# naming
# ----------------------------------------------------------------------------------------------------------------------

DISTRO = "hkaudio"
DISTRO_NAME = "Hirschkaefer Audio"

DISTRO_FEATURES_DEFAULT:remove = "3g argp irda nfc nfs pcmcia x11 zeroconf"
DISTRO_FEATURES_BACKFILL:remove = "ldconfig bluetooth pulseaudio"
DISTRO_FEATURES = "${DISTRO_FEATURES_DEFAULT} ${DISTRO_FEATURES_LIBC} systemd usrmerge"
DISTRO_FEATURES:remove = "debuginfod pci seccomp bluetooth pulseaudio"

DISTRO_VERSION = "0.1"

IMAGE_FEATURES += "ssh-server-dropbear"

LICENSE_FLAGS_ACCEPTED += "COMMERCIAL commercial"

ROOT_HOME = "/root"

# ----------------------------------------------------------------------------------------------------------------------
# policy
# ----------------------------------------------------------------------------------------------------------------------
IMAGE_FSTYPES:remove = "tar.bz2 wic.bz2"
IMAGE_FSTYPES += "tar.zst wic.zst"

#activate config checker
INHERIT += "sanity"

#run QA tests on builds and packages and log them
INHERIT += "insane"
QA_LOG = "1"

INHERIT += "buildhistory"
INHERIT += "buildstats"

# run QA tests on recipes
INHERIT += "recipe_sanity"

VIRTUAL-RUNTIME_dev_manager = "systemd"
VIRTUAL-RUNTIME_init_manager = "systemd"
DISTRO_FEATURES_BACKFILL_CONSIDERED += "sysvinit"
VIRTUAL-RUNTIME_login_manager = "busybox"
VIRTUAL-RUNTIME_syslog = ""
VIRTUAL-RUNTIME_base-utils-syslog = ""
VIRTUAL-RUNTIME_initscripts = ""

# use the en-US locale only
GLIBC_GENERATE_LOCALES = "en_US.UTF-8"
IMAGE_LINGUAS = "en-us"

IMAGE_FSTYPES += "ext3"
```

## yocto/sources/meta-hkaudio/conf/layer.conf
```bitbake
# We have a conf and classes directory, add to BBPATH
BBPATH .= ":${LAYERDIR}"

# We have recipes/* directories, add to BBFILES
BBFILES += "${LAYERDIR}/recipes/*/*.bb \
            ${LAYERDIR}/recipes/*/*.bbappend"

BBFILE_COLLECTIONS += "meta-hkaudio"
BBFILE_PATTERN_meta-hkaudio = "^${LAYERDIR}/"
BBFILE_PRIORITY_meta-hkaudio = "40"
LAYERSERIES_COMPAT_meta-hkaudio = "scarthgap"
```
